#include "moNa2.dtsi"
#include <input/processors.dtsi>
#include <dt-bindings/zmk/input_transform.h>

#define SCROLL_LAYER 5
#define MOUSE_LAYER 6

&default_transform {
    col-offset = <6>;
};

&kscan0 {
        col-gpios
            = <&xiao_d 10 GPIO_ACTIVE_HIGH>
            , <&xiao_d 9 GPIO_ACTIVE_HIGH> 
            , <&xiao_d 8 GPIO_ACTIVE_HIGH> 
            , <&xiao_d 7 GPIO_ACTIVE_HIGH> 
            , <&gpio0 10 GPIO_ACTIVE_HIGH>
            ;
};

/ {
    // Auto-Mouse Layer Input Processor
    /omit-if-no-ref/ zip_temp_layer: zip_temp_layer {
        compatible = "zmk,input-processor-temp-layer";
        #input-processor-cells = <2>;
        // Excluded positions - keys that won't exit mouse layer
        excluded-positions = 
            18 // J
            19 // K
            20 // L
            32 // Ctrl/Command + .
            33 // Shift + /
            38 // Ctrl/Command + Del
            39 // Shift + Space
>;
        >;
        // Prevent AML activation for 200ms after key input
        require-prior-idle-ms = <200>;
    };

    trackball_listener {
        compatible = "zmk,input-listener";
        device = <&trackball>;
        // Auto-Mouse Layer setup
        input-processors = <&zip_temp_layer MOUSE_LAYER 1200>;

       // Add separated vertical/horizontal scroll configurations
        scroller_vertical {
        layers = <FUNC_SCROLL_WIN FUNC_SCROLL_MAC>;
        input-processors =
        <&zip_y_scaler 1 8>,
        <&zip_x_scaler 0 1>,
        <&zip_xy_to_scroll_mapper>;
};

        scroller_horizontal {
         layers = <SYMBOL_WIN SYMBOL_MAC>;
        input-processors =
        <&zip_x_scaler 1 8>,
        <&zip_y_scaler 0 1>,
        <&zip_xy_to_scroll_mapper>;
};
        };
    };
};

&pinctrl {
    spi0_default: spi0_default {
        group1 {
            psels = <NRF_PSEL(SPIM_SCK, 0, 5)>,
                <NRF_PSEL(SPIM_MOSI, 0, 4)>,
                <NRF_PSEL(SPIM_MISO, 0, 4)>;
        };
    };

    spi0_sleep: spi0_sleep {
        group1 {
            psels = <NRF_PSEL(SPIM_SCK, 0, 5)>,
                <NRF_PSEL(SPIM_MOSI, 0, 4)>,
                <NRF_PSEL(SPIM_MISO, 0, 4)>;
            low-power-enable;
        };
    };
};

&spi0 {
    status = "okay";
    compatible = "nordic,nrf-spim";
    pinctrl-0 = <&spi0_default>;
    pinctrl-1 = <&spi0_sleep>;
    pinctrl-names = "default", "sleep";
    cs-gpios = <&gpio0 9 GPIO_ACTIVE_LOW>;

    trackball: trackball@0 {
        status = "okay";
        compatible = "pixart,pmw3610";
        reg = <0>;
        spi-max-frequency = <2000000>;
        irq-gpios = <&gpio0 2 (GPIO_ACTIVE_LOW | GPIO_PULL_UP)>;
    };
};
