## config/west.yml
```yaml
manifest:
  remotes:
    - name: zmkfirmware
      url-base: https://github.com/zmkfirmware
    - name: yamaryu211  # Changed from sayu-hub
      url-base: https://github.com/yamaryu211
    - name: caksoylar
      url-base: https://github.com/caksoylar
  projects:
    - name: zmk
      remote: zmkfirmware
      revision: main
      import: app/west.yml
    - name: zmk-pmw3610-driver
      remote: yamaryu211  # Changed from sayu-hub
      revision: feat/change-scroll-behaviour  # Advanced scroll features
    - name: zmk-rgbled-widget
      remote: caksoylar
      revision: main
  self:
    path: config
```
